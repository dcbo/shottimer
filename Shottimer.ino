/*
espresso shot timer 

## features
 - 7-Seg style graphic output on I2C-OLED display
 - temperature display 
 - control of baristlight during shot (digital or PWM)
 
by  Dario Carluucio (user dondario of http://www.kaffee-netz.de )

based on idea and hardware from 
- David Kißling (user mactree of http://www.kaffee-netz.de )
 

## todo
- [ ] change switch input to valve and measure preinfusion seperate
- [ ] design new display output if inactive
- [ ] store values in eeprom
  - no. of shots longer than MIN_SHOT_TIME - UNSIGNED LONG
  - seconds of pump operation - UNSIGNED LONG
- [x] add barista light control 

## changelog
v2.1 rev 002 - baristalight added with many configuration options 
                (pin configuration, polatity high/low active, pwm speed on/off, timeout)
v2.1 rev 001 - Complete code rewritten, baristalight still missing

## connections
  - OLED display
    - GND   connected to GND
    - SDA   connected to SDA
    - SCL   connected to SCL
    - VCC   connected to 5V 
  - switch input
    - D5    LOW ACTIVE
  - pump input
    - D6    LOW ACTIVE
  - DS1820 temperature sensor (optional)
    - GND   connected to GND
    - Data  connected to Port 2 and to a 4k7 resistor
    - VCC   connected to 5V and to the other pin of the 4k7 resistor 
  - Barista Light via relais - ON-OFF only (optional)
    - 13    polarity configurable 
  - Barista Light via MOSFET - dimmable (optional)
    - 10    polarity configurable 

## libraries needed
  - [Bounce2, Version 2.21              - https://github.com/thomasfredericks/Bounce2/
  - [DallasTemperature, Version 3.7.7   - https://github.com/milesburton/Arduino-Temperature-Control-Library
  - [MicroLCD                           - https://github.com/stanleyhuangyc/MultiLCD/tree/master/MicroLCD
  - [OneWire]                           - https://github.com/PaulStoffregen/OneWire
  - Wire                                - part of Arduino installation
*/

// ############################################################################
// libraries
// ############################################################################
#include <Bounce2.h>
#include <DallasTemperature.h>
#include <MicroLCD.h>


// ############################################################################
// hardware and other configuration 
// ############################################################################

// DS18B20 
#define ONE_WIRE_BUS            2

// digital inputs
#define INPUT_SWITCH            5   // Pumpe aktiv
#define INPUT_PUMP              6   // Start Knopf

// digital output 
#define BARISTA_LED            13   // connect to barrista light relais
#define BARISTA_LED_ACTIVE_ON   0   // set to 1 if Light turns on with logical zero, set to 0 if Light turns on with logical one
#define BARISTA_PWM            10   // connect to IRLIZ44N (GATE)
#define BARISTA_PWM_ACTIVE_ON   0   // see BARISTA_LED_ACTIVE_ON 

// Delay times
#define MIN_SHOT_TIME              5000  // minimum shot time, which is showed longer SHOW_LAST_SHOT
#define SHOW_LAST_SHOT            10000  // how long to show the last shot-time in ms
#define START_SCREEN_DELAY         5000  // how long to show the start screen in ms
#define TEMP_CONVERSION_INTERVAL   1000  // interval for temperature conversion 
#define BARISTA_PWM_DELAY_UP          1  // ms for each pwm step when powering on
#define BARISTA_PWM_DELAY_DOWN       50  // ms for each pwm step when powering down
#define BARISTA_DELAY             10000  // ms timeout for bartista lights7


// ############################################################################
// curent version
// ############################################################################
#define VER_MAJOR                 2
#define VER_MINOR                 1
#define VER_REVISION              4


// ############################################################################
// 7-segemnt graphic characterset
// ############################################################################

const PROGMEM uint8_t seven_seg[11][192] = {
// 0  
{
0x00,0x00,0x00,0xC8,0xDC,0xDE,0x9E,0xBE,0x3E,0x3E,0x3E,0x3E,0x3E,0x3E,0x3E,0x3E,0x3E,0x3E,0x3E,0x3E,0x3E,0x3E,0x3E,0x3E,0x0E,0xE0,0xFC,0xFE,0xFC,0xF8,0x00,0x00,
0x00,0x00,0x00,0xFF,0xFF,0xFF,0xFF,0xFF,0x00,0x00,0x00,0x00,0x00,0x00,0x00,0x00,0x00,0x00,0x00,0x00,0x00,0x00,0x00,0x00,0x00,0xFF,0xFF,0xFF,0xFF,0xFF,0x00,0x00,
0x00,0x00,0x00,0x3F,0x7F,0x3F,0x1F,0x0F,0x00,0x00,0x00,0x00,0x00,0x00,0x00,0x00,0x00,0x00,0x00,0x00,0x00,0x00,0x00,0x00,0x00,0x0F,0x1F,0x3F,0x7F,0x3F,0x00,0x00,
0x00,0x00,0x00,0xFC,0xFE,0xFC,0xF8,0xF0,0x00,0x00,0x00,0x00,0x00,0x00,0x00,0x00,0x00,0x00,0x00,0x00,0x00,0x00,0x00,0x00,0x00,0xF0,0xF8,0xFC,0xFE,0xFC,0x00,0x00,
0x00,0x00,0x00,0xFF,0xFF,0xFF,0xFF,0xFF,0x00,0x00,0x00,0x00,0x00,0x00,0x00,0x00,0x00,0x00,0x00,0x00,0x00,0x00,0x00,0x00,0x00,0xFF,0xFF,0xFF,0xFF,0xFF,0x00,0x00,
0x00,0x00,0x00,0x13,0x3B,0x7B,0x79,0x7D,0x7C,0x7C,0x7C,0x7C,0x7C,0x7C,0x7C,0x7C,0x7C,0x7C,0x7C,0x7C,0x7C,0x7C,0x7C,0x7C,0x70,0x07,0x3F,0x7F,0x3F,0x1F,0x00,0x00
} ,
// 1
{
0x00,0x00,0x00,0x00,0x00,0x00,0x00,0x00,0x00,0x00,0x00,0x00,0x00,0x00,0x00,0x00,0x00,0x00,0x00,0x00,0x00,0x00,0x00,0x00,0x00,0xE0,0xFC,0xFE,0xFC,0xF8,0x00,0x00,
0x00,0x00,0x00,0x00,0x00,0x00,0x00,0x00,0x00,0x00,0x00,0x00,0x00,0x00,0x00,0x00,0x00,0x00,0x00,0x00,0x00,0x00,0x00,0x00,0x00,0xFF,0xFF,0xFF,0xFF,0xFF,0x00,0x00,
0x00,0x00,0x00,0x00,0x00,0x00,0x00,0x00,0x00,0x00,0x00,0x00,0x00,0x00,0x00,0x00,0x00,0x00,0x00,0x00,0x00,0x00,0x00,0x00,0x00,0x0F,0x1F,0x3F,0x7F,0x7F,0x00,0x00,
0x00,0x00,0x00,0x00,0x00,0x00,0x00,0x00,0x00,0x00,0x00,0x00,0x00,0x00,0x00,0x00,0x00,0x00,0x00,0x00,0x00,0x00,0x00,0x00,0x00,0xF0,0xF8,0xFC,0xFE,0xFE,0x00,0x00,
0x00,0x00,0x00,0x00,0x00,0x00,0x00,0x00,0x00,0x00,0x00,0x00,0x00,0x00,0x00,0x00,0x00,0x00,0x00,0x00,0x00,0x00,0x00,0x00,0x00,0xFF,0xFF,0xFF,0xFF,0xFF,0x00,0x00,
0x00,0x00,0x00,0x00,0x00,0x00,0x00,0x00,0x00,0x00,0x00,0x00,0x00,0x00,0x00,0x00,0x00,0x00,0x00,0x00,0x00,0x00,0x00,0x00,0x00,0x07,0x3F,0x7F,0x3F,0x1F,0x00,0x00
},
// 2
{
0x00,0x00,0x00,0x08,0x1C,0x1E,0x1E,0x3E,0x3E,0x3E,0x3E,0x3E,0x3E,0x3E,0x3E,0x3E,0x3E,0x3E,0x3E,0x3E,0x3E,0x3E,0x3E,0x3E,0x0E,0xE0,0xFC,0xFE,0xFC,0xF8,0x00,0x00,
0x00,0x00,0x00,0x00,0x00,0x00,0x00,0x00,0x00,0x00,0x00,0x00,0x00,0x00,0x00,0x00,0x00,0x00,0x00,0x00,0x00,0x00,0x00,0x00,0x00,0xFF,0xFF,0xFF,0xFF,0xFF,0x00,0x00,
0x00,0x00,0x00,0x00,0x00,0x00,0x80,0xC0,0xC0,0xC0,0xC0,0xC0,0xC0,0xC0,0xC0,0xC0,0xC0,0xC0,0xC0,0xC0,0xC0,0xC0,0xC0,0xC0,0xC0,0xCF,0x9F,0x3F,0x7F,0x3F,0x00,0x00,
0x00,0x00,0x00,0xFC,0xFE,0xFD,0xFB,0xF7,0x07,0x07,0x07,0x07,0x07,0x07,0x07,0x07,0x07,0x07,0x07,0x07,0x07,0x07,0x07,0x07,0x07,0x07,0x03,0x01,0x00,0x00,0x00,0x00,
0x00,0x00,0x00,0xFF,0xFF,0xFF,0xFF,0xFF,0x00,0x00,0x00,0x00,0x00,0x00,0x00,0x00,0x00,0x00,0x00,0x00,0x00,0x00,0x00,0x00,0x00,0x00,0x00,0x00,0x00,0x00,0x00,0x00,
0x00,0x00,0x00,0x13,0x3B,0x7B,0x79,0x7D,0x7C,0x7C,0x7C,0x7C,0x7C,0x7C,0x7C,0x7C,0x7C,0x7C,0x7C,0x7C,0x7C,0x7C,0x7C,0x7C,0x7C,0x7C,0x70,0x00,0x00,0x00,0x00,0x00
},
// 3
{
0x00,0x00,0x00,0x00,0x1C,0x1E,0x1E,0x3E,0x3E,0x3E,0x3E,0x3E,0x3E,0x3E,0x3E,0x3E,0x3E,0x3E,0x3E,0x3E,0x3E,0x3E,0x3E,0x3E,0x0E,0xE0,0xFC,0xFE,0xFC,0xF8,0x00,0x00,
0x00,0x00,0x00,0x00,0x00,0x00,0x00,0x00,0x00,0x00,0x00,0x00,0x00,0x00,0x00,0x00,0x00,0x00,0x00,0x00,0x00,0x00,0x00,0x00,0x00,0xFF,0xFF,0xFF,0xFF,0xFF,0x00,0x00,
0x00,0x00,0x00,0x00,0x00,0x00,0x00,0x80,0xC0,0xC0,0xC0,0xC0,0xC0,0xC0,0xC0,0xC0,0xC0,0xC0,0xC0,0xC0,0xC0,0xC0,0xC0,0xC0,0xC0,0xCF,0x9F,0x3F,0x7F,0x3F,0x00,0x00,
0x00,0x00,0x00,0x00,0x00,0x00,0x01,0x03,0x07,0x07,0x07,0x07,0x07,0x07,0x07,0x07,0x07,0x07,0x07,0x07,0x07,0x07,0x07,0x07,0x07,0xF7,0xFB,0xFD,0xFE,0xFC,0x00,0x00,
0x00,0x00,0x00,0x00,0x00,0x00,0x00,0x00,0x00,0x00,0x00,0x00,0x00,0x00,0x00,0x00,0x00,0x00,0x00,0x00,0x00,0x00,0x00,0x00,0x00,0xFF,0xFF,0xFF,0xFF,0xFF,0x00,0x00,
0x00,0x00,0x00,0x00,0x38,0x78,0x78,0x7C,0x7C,0x7C,0x7C,0x7C,0x7C,0x7C,0x7C,0x7C,0x7C,0x7C,0x7C,0x7C,0x7C,0x7C,0x7C,0x7C,0x70,0x07,0x3F,0x7F,0x3F,0x1F,0x00,0x00
},
// 4
{
0x00,0x00,0x00,0xF0,0xF0,0xF0,0xE0,0xE0,0x00,0x00,0x00,0x00,0x00,0x00,0x00,0x00,0x00,0x00,0x00,0x00,0x00,0x00,0x00,0x00,0x00,0xE0,0xFC,0xFE,0xFC,0xF8,0x00,0x00,
0x00,0x00,0x00,0xFF,0xFF,0xFF,0xFF,0xFF,0x00,0x00,0x00,0x00,0x00,0x00,0x00,0x00,0x00,0x00,0x00,0x00,0x00,0x00,0x00,0x00,0x00,0xFF,0xFF,0xFF,0xFF,0xFF,0x00,0x00,
0x00,0x00,0x00,0x7F,0x7F,0x3F,0x9F,0xCF,0xC0,0xC0,0xC0,0xC0,0xC0,0xC0,0xC0,0xC0,0xC0,0xC0,0xC0,0xC0,0xC0,0xC0,0xC0,0xC0,0xC0,0xCF,0x9F,0x3F,0x7F,0x7F,0x00,0x00,
0x00,0x00,0x00,0x00,0x00,0x01,0x03,0x07,0x07,0x07,0x07,0x07,0x07,0x07,0x07,0x07,0x07,0x07,0x07,0x07,0x07,0x07,0x07,0x07,0x07,0xF7,0xFB,0xFD,0xFE,0xFE,0x00,0x00,
0x00,0x00,0x00,0x00,0x00,0x00,0x00,0x00,0x00,0x00,0x00,0x00,0x00,0x00,0x00,0x00,0x00,0x00,0x00,0x00,0x00,0x00,0x00,0x00,0x00,0xFF,0xFF,0xFF,0xFF,0xFF,0x00,0x00,
0x00,0x00,0x00,0x00,0x00,0x00,0x00,0x00,0x00,0x00,0x00,0x00,0x00,0x00,0x00,0x00,0x00,0x00,0x00,0x00,0x00,0x00,0x00,0x00,0x00,0x07,0x3F,0x7F,0x3F,0x1F,0x00,0x00
},
// 5
{
0x00,0x00,0x00,0xC8,0xDC,0xDE,0x9E,0xBE,0x3E,0x3E,0x3E,0x3E,0x3E,0x3E,0x3E,0x3E,0x3E,0x3E,0x3E,0x3E,0x3E,0x3E,0x3E,0x3E,0x3E,0x3E,0x0E,0x00,0x00,0x00,0x00,0x00,
0x00,0x00,0x00,0xFF,0xFF,0xFF,0xFF,0xFF,0x00,0x00,0x00,0x00,0x00,0x00,0x00,0x00,0x00,0x00,0x00,0x00,0x00,0x00,0x00,0x00,0x00,0x00,0x00,0x00,0x00,0x00,0x00,0x00,
0x00,0x00,0x00,0x3F,0x7F,0x3F,0x9F,0xCF,0xC0,0xC0,0xC0,0xC0,0xC0,0xC0,0xC0,0xC0,0xC0,0xC0,0xC0,0xC0,0xC0,0xC0,0xC0,0xC0,0xC0,0xC0,0x80,0x00,0x00,0x00,0x00,0x00,
0x00,0x00,0x00,0x00,0x00,0x01,0x03,0x07,0x07,0x07,0x07,0x07,0x07,0x07,0x07,0x07,0x07,0x07,0x07,0x07,0x07,0x07,0x07,0x07,0x07,0xF7,0xFB,0xFD,0xFE,0xFC,0x00,0x00,
0x00,0x00,0x00,0x00,0x00,0x00,0x00,0x00,0x00,0x00,0x00,0x00,0x00,0x00,0x00,0x00,0x00,0x00,0x00,0x00,0x00,0x00,0x00,0x00,0x00,0xFF,0xFF,0xFF,0xFF,0xFF,0x00,0x00,
0x00,0x00,0x00,0x10,0x38,0x78,0x78,0x7C,0x7C,0x7C,0x7C,0x7C,0x7C,0x7C,0x7C,0x7C,0x7C,0x7C,0x7C,0x7C,0x7C,0x7C,0x7C,0x7C,0x70,0x07,0x3F,0x7F,0x3F,0x1F,0x00,0x00
},
// 6 
{
0x00,0x00,0x00,0xC8,0xDC,0xDE,0x9E,0xBE,0x3E,0x3E,0x3E,0x3E,0x3E,0x3E,0x3E,0x3E,0x3E,0x3E,0x3E,0x3E,0x3E,0x3E,0x3E,0x3E,0x3E,0x3E,0x0E,0x00,0x00,0x00,0x00,0x00,
0x00,0x00,0x00,0xFF,0xFF,0xFF,0xFF,0xFF,0x00,0x00,0x00,0x00,0x00,0x00,0x00,0x00,0x00,0x00,0x00,0x00,0x00,0x00,0x00,0x00,0x00,0x00,0x00,0x00,0x00,0x00,0x00,0x00,
0x00,0x00,0x00,0x3F,0x7F,0x3F,0x9F,0xCF,0xC0,0xC0,0xC0,0xC0,0xC0,0xC0,0xC0,0xC0,0xC0,0xC0,0xC0,0xC0,0xC0,0xC0,0xC0,0xC0,0xC0,0xC0,0x80,0x00,0x00,0x00,0x00,0x00,
0x00,0x00,0x00,0xFC,0xFE,0xFD,0xFB,0xF7,0x07,0x07,0x07,0x07,0x07,0x07,0x07,0x07,0x07,0x07,0x07,0x07,0x07,0x07,0x07,0x07,0x07,0xF7,0xFB,0xFD,0xFE,0xFC,0x00,0x00,
0x00,0x00,0x00,0xFF,0xFF,0xFF,0xFF,0xFF,0x00,0x00,0x00,0x00,0x00,0x00,0x00,0x00,0x00,0x00,0x00,0x00,0x00,0x00,0x00,0x00,0x00,0xFF,0xFF,0xFF,0xFF,0xFF,0x00,0x00,
0x00,0x00,0x00,0x13,0x3B,0x7B,0x79,0x7D,0x7C,0x7C,0x7C,0x7C,0x7C,0x7C,0x7C,0x7C,0x7C,0x7C,0x7C,0x7C,0x7C,0x7C,0x7C,0x7C,0x70,0x07,0x3F,0x7F,0x3F,0x1F,0x00,0x00
},
// 7 
{
0x00,0x00,0x00,0xC8,0xDC,0xDE,0x9E,0xBE,0x3E,0x3E,0x3E,0x3E,0x3E,0x3E,0x3E,0x3E,0x3E,0x3E,0x3E,0x3E,0x3E,0x3E,0x3E,0x3E,0x0E,0xE0,0xFC,0xFE,0xFC,0xF8,0x00,0x00,
0x00,0x00,0x00,0xFF,0xFF,0xFF,0xFF,0xFF,0x00,0x00,0x00,0x00,0x00,0x00,0x00,0x00,0x00,0x00,0x00,0x00,0x00,0x00,0x00,0x00,0x00,0xFF,0xFF,0xFF,0xFF,0xFF,0x00,0x00,
0x00,0x00,0x00,0x3F,0x7F,0x3F,0x1F,0x0F,0x00,0x00,0x00,0x00,0x00,0x00,0x00,0x00,0x00,0x00,0x00,0x00,0x00,0x00,0x00,0x00,0x00,0x0F,0x1F,0x3F,0x7F,0x3F,0x00,0x00,
0x00,0x00,0x00,0x00,0x00,0x00,0x00,0x00,0x00,0x00,0x00,0x00,0x00,0x00,0x00,0x00,0x00,0x00,0x00,0x00,0x00,0x00,0x00,0x00,0x00,0xF0,0xF8,0xFC,0xFE,0xFE,0x00,0x00,
0x00,0x00,0x00,0x00,0x00,0x00,0x00,0x00,0x00,0x00,0x00,0x00,0x00,0x00,0x00,0x00,0x00,0x00,0x00,0x00,0x00,0x00,0x00,0x00,0x00,0xFF,0xFF,0xFF,0xFF,0xFF,0x00,0x00,
0x00,0x00,0x00,0x00,0x00,0x00,0x00,0x00,0x00,0x00,0x00,0x00,0x00,0x00,0x00,0x00,0x00,0x00,0x00,0x00,0x00,0x00,0x00,0x00,0x00,0x07,0x3F,0x7F,0x3F,0x1F,0x00,0x00
},
// 8 
{
0x00,0x00,0x00,0xC8,0xDC,0xDE,0x9E,0xBE,0x3E,0x3E,0x3E,0x3E,0x3E,0x3E,0x3E,0x3E,0x3E,0x3E,0x3E,0x3E,0x3E,0x3E,0x3E,0x3E,0x0E,0xE0,0xFC,0xFE,0xFC,0xF8,0x00,0x00,
0x00,0x00,0x00,0xFF,0xFF,0xFF,0xFF,0xFF,0x00,0x00,0x00,0x00,0x00,0x00,0x00,0x00,0x00,0x00,0x00,0x00,0x00,0x00,0x00,0x00,0x00,0xFF,0xFF,0xFF,0xFF,0xFF,0x00,0x00,
0x00,0x00,0x00,0x3F,0x7F,0x3F,0x9F,0xCF,0xC0,0xC0,0xC0,0xC0,0xC0,0xC0,0xC0,0xC0,0xC0,0xC0,0xC0,0xC0,0xC0,0xC0,0xC0,0xC0,0xC0,0xCF,0x9F,0x3F,0x7F,0x3F,0x00,0x00,
0x00,0x00,0x00,0xFC,0xFE,0xFD,0xFB,0xF7,0x07,0x07,0x07,0x07,0x07,0x07,0x07,0x07,0x07,0x07,0x07,0x07,0x07,0x07,0x07,0x07,0x07,0xF7,0xFB,0xFD,0xFE,0xFC,0x00,0x00,
0x00,0x00,0x00,0xFF,0xFF,0xFF,0xFF,0xFF,0x00,0x00,0x00,0x00,0x00,0x00,0x00,0x00,0x00,0x00,0x00,0x00,0x00,0x00,0x00,0x00,0x00,0xFF,0xFF,0xFF,0xFF,0xFF,0x00,0x00,
0x00,0x00,0x00,0x13,0x3B,0x7B,0x79,0x7D,0x7C,0x7C,0x7C,0x7C,0x7C,0x7C,0x7C,0x7C,0x7C,0x7C,0x7C,0x7C,0x7C,0x7C,0x7C,0x7C,0x70,0x07,0x3F,0x7F,0x3F,0x1F,0x00,0x00
},
// 9
{
0x00,0x00,0x00,0xC8,0xDC,0xDE,0x9E,0xBE,0x3E,0x3E,0x3E,0x3E,0x3E,0x3E,0x3E,0x3E,0x3E,0x3E,0x3E,0x3E,0x3E,0x3E,0x3E,0x3E,0x0E,0xE0,0xFC,0xFE,0xFC,0xF8,0x00,0x00,
0x00,0x00,0x00,0xFF,0xFF,0xFF,0xFF,0xFF,0x00,0x00,0x00,0x00,0x00,0x00,0x00,0x00,0x00,0x00,0x00,0x00,0x00,0x00,0x00,0x00,0x00,0xFF,0xFF,0xFF,0xFF,0xFF,0x00,0x00,
0x00,0x00,0x00,0x3F,0x7F,0x3F,0x9F,0xCF,0xC0,0xC0,0xC0,0xC0,0xC0,0xC0,0xC0,0xC0,0xC0,0xC0,0xC0,0xC0,0xC0,0xC0,0xC0,0xC0,0xC0,0xCF,0x9F,0x3F,0x7F,0x3F,0x00,0x00,
0x00,0x00,0x00,0x00,0x00,0x01,0x03,0x07,0x07,0x07,0x07,0x07,0x07,0x07,0x07,0x07,0x07,0x07,0x07,0x07,0x07,0x07,0x07,0x07,0x07,0xF7,0xFB,0xFD,0xFE,0xFC,0x00,0x00,
0x00,0x00,0x00,0x00,0x00,0x00,0x00,0x00,0x00,0x00,0x00,0x00,0x00,0x00,0x00,0x00,0x00,0x00,0x00,0x00,0x00,0x00,0x00,0x00,0x00,0xFF,0xFF,0xFF,0xFF,0xFF,0x00,0x00,
0x00,0x00,0x00,0x10,0x38,0x78,0x78,0x7C,0x7C,0x7C,0x7C,0x7C,0x7C,0x7C,0x7C,0x7C,0x7C,0x7C,0x7C,0x7C,0x7C,0x7C,0x7C,0x7C,0x70,0x07,0x3F,0x7F,0x3F,0x1F,0x00,0x00
},
// -
{ 
0x00,0x00,0x00,0x00,0x00,0x00,0x00,0x00,0x00,0x00,0x00,0x00,0x00,0x00,0x00,0x00,0x00,0x00,0x00,0x00,0x00,0x00,0x00,0x00,0x00,0x00,0x00,0x00,0x00,0x00,0x00,0x00,
0x00,0x00,0x00,0x00,0x00,0x00,0x00,0x00,0x00,0x00,0x00,0x00,0x00,0x00,0x00,0x00,0x00,0x00,0x00,0x00,0x00,0x00,0x00,0x00,0x00,0x00,0x00,0x00,0x00,0x00,0x00,0x00,
0x00,0x00,0x00,0x00,0x00,0x00,0x00,0x80,0xC0,0xC0,0xC0,0xC0,0xC0,0xC0,0xC0,0xC0,0xC0,0xC0,0xC0,0xC0,0xC0,0xC0,0xC0,0xC0,0xC0,0xC0,0xC0,0xC0,0x80,0x00,0x00,0x00,
0x00,0x00,0x00,0x00,0x00,0x00,0x01,0x03,0x07,0x07,0x07,0x07,0x07,0x07,0x07,0x07,0x07,0x07,0x07,0x07,0x07,0x07,0x07,0x07,0x07,0x07,0x07,0x07,0x03,0x01,0x00,0x00,
0x00,0x00,0x00,0x00,0x00,0x00,0x00,0x00,0x00,0x00,0x00,0x00,0x00,0x00,0x00,0x00,0x00,0x00,0x00,0x00,0x00,0x00,0x00,0x00,0x00,0x00,0x00,0x00,0x00,0x00,0x00,0x00,
0x00,0x00,0x00,0x00,0x00,0x00,0x00,0x00,0x00,0x00,0x00,0x00,0x00,0x00,0x00,0x00,0x00,0x00,0x00,0x00,0x00,0x00,0x00,0x00,0x00,0x00,0x00,0x00,0x00,0x00,0x00,0x00,
}
};

const PROGMEM uint8_t degree[] = {
0x00,0x00,0x06,0x09,0x09,0x06,0x00,0x00,0x00,0x00,0x00,0x00,0x00,0x00,0x00,0x00
};

// Display states
#define DSP_NOTHING       0
#define DSP_STARTSCREEN   1
#define DSP_TIME          2
#define DSP_STANDBY_TEMP  3
#define DSP_STANDBY       4


// ############################################################################
// global vars
// ############################################################################
Bounce g_bounce_switch = Bounce();      // debouncing Start Button
Bounce g_bounce_pump   = Bounce();      // debouncing Pump Optocoupler
OneWire oneWire(ONE_WIRE_BUS);          // One Wire Bus
DallasTemperature sensors(&oneWire);    // DS1820
LCD_SSD1306 lcd;                        // OLED on I2C-bus 

int           g_displaymode;                 // actual display mode   
unsigned long g_duration_last;               // maximum of both duration
unsigned long g_last_display_update;         // last update of display
boolean       g_last_display_overflow;       // display shows overflow
boolean       g_led_on;
boolean       g_pump_last = false;
unsigned long g_pump_started_at;
unsigned long g_pump_stoped_at;
byte          g_pwm_act;                     // actual value for barista light PWM
unsigned long g_pwm_laststep;
byte          g_pwm_setpoint;                // setpoint for barista light PWM
boolean       g_sensorFound;
unsigned long g_start_screen_update;         // time when StartScreen was written
boolean       g_switch_last = false;
unsigned long g_switch_started_at;
unsigned long g_switch_stoped_at;
boolean       g_temp_value_valid ;           // temperature conversion is finished
boolean       g_temp_conversion_running;     // temperature conversion is currently running
unsigned long g_temp_conversion_stared;      // time when last temperature conversion started
float         g_temp_value;                  // result of temperature conversion in degree
float         g_temp_value_last;             // result of last temperature conversion in degree
   

// ############################################################################
// functions
// ############################################################################
// Show Startscreen 
void showStartScreen(void){
    lcd.clear();
    lcd.setFontSize(FONT_SIZE_MEDIUM);
    lcd.setCursor(5, 0);    
    lcd.print(F("Espresso"));
    lcd.setCursor(5, 3);    
    lcd.print(F("Shot Timer"));
    lcd.setFontSize(FONT_SIZE_SMALL);
    lcd.setCursor(40, 7);    
    lcd.print(F("v "));
    lcd.print(VER_MAJOR);
    lcd.print(F("."));
    lcd.print(VER_MINOR);
    lcd.print(F(" rev "));    
    lcd.print(VER_REVISION);
    g_displaymode = DSP_STARTSCREEN;
    g_start_screen_update = millis();  
}

// turn barista LED on and of
void switch_barista_led(boolean state){
    if (state) {        
        Serial.println(F("LED On"));   
        #if (BARISTA_LED_ACTIVE_ON == 1)
            digitalWrite(BARISTA_LED, HIGH);
        #else
            digitalWrite(BARISTA_LED, LOW);
        #endif
    } else {        
        Serial.println(F("LED Off"));   
        #if (BARISTA_LED_ACTIVE_ON == 1)
            digitalWrite(BARISTA_LED, LOW);
        #else
            digitalWrite(BARISTA_LED, HIGH);
        #endif
    }
}

// control barista PWM
void switch_barista_pwm(byte value){
    Serial.print(F("PWM:"));   
    Serial.println(value,DEC);   
    if (value == 0){
        // turn off, without PWM
        #if (BARISTA_PWM_ACTIVE_ON == 1)
            digitalWrite(BARISTA_PWM, LOW);        
        #else
            digitalWrite(BARISTA_PWM, HIGH);        
        #endif
    } else if (value == 255){
        // turn on, without PWM
        #if (BARISTA_PWM_ACTIVE_ON == 1)
            digitalWrite(BARISTA_PWM, HIGH);        
        #else
            digitalWrite(BARISTA_PWM, LOW);        
        #endif
    } else {
        // set value withPWM
        #if (BARISTA_PWM_ACTIVE_ON == 1)
            analogWrite(BARISTA_PWM, value);        
        #else
            analogWrite(BARISTA_PWM, 255 - value);        
        #endif
    }
}


// check for temperature sensor
boolean isTempSensorOnline(void){
    float temp;
    boolean res;
    sensors.setWaitForConversion(true);
    sensors.requestTemperatures();  
    temp = sensors.getTempCByIndex(0),1;
    if ( temp > 0) {
        res = true;
        sensors.setWaitForConversion(false);
    } else {
        res= false;  
    }
    return res;
}

// show shottime in 7-segment style
// value: time to be displayed [100ms]
void displaytime(int value) {
    byte digit;
    if (value > 999) {
        if (!g_last_display_overflow) {
            lcd.clear();
            lcd.setCursor(25, 2);
            lcd.draw(seven_seg[10], 32, 48);
            lcd.setCursor(61, 2);
            lcd.draw(seven_seg[10], 32, 48);
            g_last_display_overflow = true;
        }
    } else {
        g_last_display_overflow = false;
        lcd.setCursor(25, 1);
        digit = value / 100;
        lcd.draw(seven_seg[digit], 32, 48);
        lcd.setCursor(61, 1);
        digit = value / 10 % 10;
        lcd.draw(seven_seg[digit], 32, 48);  
        lcd.setCursor(94, 5);
        lcd.print(".");
        lcd.setCursor(104, 5);
        digit = value % 10;
        lcd.print(digit);
    }
}


// ############################################################################
// setup
// ############################################################################
void setup() {
    // Setup Serial
    Serial.begin(19200);
    delay(100);
    Serial.println(F("Init."));   
  
    // Init Global Vars
    Serial.println(F("Init Global Vars"));   
    g_displaymode = DSP_NOTHING;
    g_duration_last = 0;               
    g_last_display_update = millis();  
    g_last_display_overflow = false;
    g_led_on = false;
    g_pump_started_at = millis();
    g_pump_stoped_at = millis();
    g_pwm_act=0;
    g_pwm_laststep = millis();
    g_pwm_setpoint=0;
    g_sensorFound = false;
    g_start_screen_update = millis();
    g_switch_last = false;
    g_switch_started_at = millis();
    g_switch_stoped_at = millis();
    g_temp_value_valid  = false;
    g_temp_conversion_running = false;
    g_temp_conversion_stared = millis();
    g_temp_value = -10;
    g_temp_value_last = -10;
  
    // Init Input: Start 
    Serial.println(F("Init Input"));   
    pinMode(INPUT_SWITCH, INPUT);
    digitalWrite(INPUT_SWITCH, HIGH);
    g_bounce_switch.attach(INPUT_SWITCH);
    g_bounce_switch.interval(50);
    
    // Init Input: Pump 
    pinMode(INPUT_PUMP, INPUT);
    digitalWrite(INPUT_PUMP, HIGH);
    g_bounce_pump.attach(INPUT_PUMP);
    g_bounce_pump.interval(50);
   
    // Init Output: Barista Light - LED
    pinMode(BARISTA_LED, OUTPUT);
    switch_barista_led(false);
        
    // Init Output: Barista Light - PWM
    pinMode(BARISTA_PWM , OUTPUT);    
    switch_barista_pwm(0);
    
    // Init LCD  
    Serial.println(F("Init LCD"));   
    lcd.begin();
    showStartScreen();
    lcd.setFontSize(FONT_SIZE_MEDIUM);
  
    // DS1820
    Serial.print(F("Init DS1820 ..."));   
    sensors.setWaitForConversion(false);
    sensors.begin();
    g_sensorFound = isTempSensorOnline();
    if (g_sensorFound) {
      Serial.println(F("found"));   
    } else {
      Serial.println(F("NOT found"));   
    }
}


// ############################################################################
// main loop
// ############################################################################
void loop() {
    boolean               pump_act;
    boolean               switch_act; 
    unsigned long         switch_duration;             // activity in 0.1s (100ms) 
    unsigned long         pump_duration;               // activity in 0.1s (100ms) 
    unsigned long         duration;                    // maximum of both duration
    
    // read input switch 
    g_bounce_switch.update ( );
    switch_act = !g_bounce_switch.read();
    
    // read pump state 
    g_bounce_pump.update ( );
    pump_act   = !g_bounce_pump.read();
    
    // any changes in pump state?
    if (pump_act != g_pump_last){
        Serial.print(F("Pump: "));   
        g_pump_last = pump_act;
        if (pump_act) {
            Serial.println(F("activated"));   
            g_pump_started_at = millis();   
        } else {
            Serial.println(F("disactivated"));   
            g_pump_stoped_at = millis();   
        }
    }
  
    // any changes in switch state?
    if (switch_act != g_switch_last){
        Serial.print(F("Switch: "));   
        g_switch_last = switch_act;
        if (switch_act) {
            Serial.println(F("activated"));   
            g_switch_started_at = millis();   
        } else {
            Serial.println(F("disactivated"));   
            g_switch_stoped_at = millis();   
        }
    }
    
    // how long is each signal active?
    if (switch_act){
        switch_duration = (millis() - g_switch_started_at) / 100;
    } else {
        switch_duration = 0;
    }
    if (pump_act){
        pump_duration = (millis() - g_pump_started_at) / 100;
    } else {
        pump_duration = 0;
    }
  
    // maximum of both durations
    if (pump_duration > switch_duration){
        duration = pump_duration;
    } else {
        duration = switch_duration;
    }
    
    // switch barista lights on when 
    // - barista lights are of
    // - and timer is running
    if ( (switch_act || pump_act) && (!g_led_on) ){
        g_led_on = true;        
        switch_barista_led(g_led_on);        
        g_pwm_setpoint = 255;
    }
    
    // switch barista lights off when
    // - barista lights are on
    // - timer is not running
    if (!switch_act && !pump_act && g_led_on){
        if ( ((millis() - g_pump_stoped_at) > BARISTA_DELAY) && ((millis() - g_switch_stoped_at) > BARISTA_DELAY) ) {
            g_led_on = false;                        
            switch_barista_led(g_led_on);
            g_pwm_setpoint = 0;            
        }
    }
    
    // control baristalight pwm power down
    if (g_pwm_act > g_pwm_setpoint){
        if ( (millis() - g_pwm_laststep) > BARISTA_PWM_DELAY_DOWN ) {
            g_pwm_laststep = millis();
            g_pwm_act--;
            switch_barista_pwm(g_pwm_act);
        }
    }
    // control baristalight pwm power up
    if (g_pwm_act < g_pwm_setpoint){
        if ( (millis() - g_pwm_laststep) > BARISTA_PWM_DELAY_UP ) {
            g_pwm_laststep = millis();
            g_pwm_act++;
            switch_barista_pwm(g_pwm_act);
        }
    }

    // display time if switch or pump active 
    if (switch_act || pump_act){
        if (duration != g_duration_last) {
            Serial.print(F("Duration: "));
            Serial.println(duration);
            g_duration_last = duration;
            // Display max duration
            if (g_displaymode != DSP_TIME) {
                lcd.clear();
                g_last_display_overflow = false;
            }
            g_displaymode = DSP_TIME;
            displaytime(duration);
            g_last_display_update = millis();
        }
    } else {
        // if nothing running, delete display if last shot after SHOW_LAST_SHOT
        // or shot was shorter than MIN_SHOT_TIME
        if (g_displaymode == DSP_TIME){
            if ( (g_duration_last < (MIN_SHOT_TIME/100) ) || ( (millis() - g_last_display_update) > SHOW_LAST_SHOT) ){
                Serial.println(F("Display Off"));   
                g_displaymode = DSP_NOTHING;
                g_temp_value_last = -10;
                lcd.clear();
            } 
        }
        // if nothing running: delete Startscreen after START_SCREEN_DELAY
        if (g_displaymode == DSP_STARTSCREEN){
            if ( (millis() - g_start_screen_update) > START_SCREEN_DELAY){
                Serial.println(F("Display: OFF"));   
                g_displaymode = DSP_NOTHING;
                g_temp_value_last = -10;
                lcd.clear();
            } 
        }
    }
    
    // switch to show temp, but only if display is empty and tempsensor detected
    if (g_displaymode == DSP_NOTHING) {
        if (g_sensorFound){
            // standby display with temperature
             g_displaymode = DSP_STANDBY_TEMP;  
             Serial.println(F("Display: DSP_STANDBY_TEMP"));   
        } else {
            // standby display without temperature
            g_displaymode = DSP_STANDBY;  
            Serial.println(F("Display: DSP_STANDBY"));   
        }
       lcd.clear();
    }
  
    // show temp if displaymode is DSP_TEMP and we have a valid temperature
    if ((g_displaymode == DSP_STANDBY_TEMP) || (g_displaymode == DSP_STANDBY)){
        if (g_temp_value != g_temp_value_last){
            g_temp_value_last = g_temp_value;
            // Serial.print(F("Display Temp: "));   
            // Serial.println(g_temp_value);   
            lcd.setCursor(5, 0);
            lcd.print("Temp: ");
            if (g_temp_value_valid) {
                lcd.println(g_temp_value);
            } else {
                lcd.println("invalid");
            }
        }
    }  
  
    // temperature conversion
    if ( g_sensorFound ){
        // is conversion currently running?
        if (g_temp_conversion_running) {
            // is enough time passed since conversion started? 
            if ( (millis() - g_temp_conversion_stared) > TEMP_CONVERSION_INTERVAL ) {
                // resad value from DS1820
                g_temp_value = sensors.getTempCByIndex(0),1;
                g_temp_conversion_running = false;
                g_temp_value_valid = true;
                // Serial.print(F("Conversion finished: "));   
                // Serial.println(g_temp_value);   
            }
        } else {
            // no conversion running, so lets start a new one
            // Serial.println(F("Start new conversion"));   
            sensors.requestTemperatures(); 
            g_temp_conversion_stared = millis();
            g_temp_conversion_running = true;
        }
    }
}
  
